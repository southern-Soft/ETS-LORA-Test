## Code from Redwan/rak3112_with_ETS_and_Careflow_ESPidf/Rak3112_ETS_CAREFLOW/sdkconfig.defaults
```kconfig
CONFIG_FREERTOS_HZ=1000
CONFIG_AUTOSTART_ARDUINO=y
CONFIG_ARDUINO_LOOP_STACK_SIZE=8192
CONFIG_ARDUINO_RUN_CORE1=y
CONFIG_ARDUINO_RUNNING_CORE=1
CONFIG_ARDUINO_EVENT_RUNNING_CORE=1
CONFIG_ESP_MAIN_TASK_STACK_SIZE=8192
```
